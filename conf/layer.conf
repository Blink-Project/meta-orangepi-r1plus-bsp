## conf/layer.conf
```bitbake
# We have a conf and classes directory, add to BBPATH
BBPATH .= ":${LAYERDIR}"

# We have recipes-* directories, add to BBFILES
BBFILES += "${LAYERDIR}/recipes-*/*/*.bb \
            ${LAYERDIR}/recipes-*/*/*.bbappend"

BBFILE_COLLECTIONS += "meta-orangepi-r1plus-bsp"
BBFILE_PATTERN_meta-orangepi-r1plus-bsp = "^${LAYERDIR}/"
BBFILE_PRIORITY_meta-orangepi-r1plus-bsp = "50"

LAYERDEPENDS_meta-orangepi-r1plus-bsp = "core meta-python"
LAYERSERIES_COMPAT_meta-orangepi-r1plus-bsp = "gatesgarth hardknott"

# Additional license directories.
LICENSE_PATH += "${LAYERDIR}/licenses"

METAOPIBASE = '${@os.path.normpath("${LAYERDIR}")}'
```

## conf/machine/orangepi-r1plus-lts.conf
```bitbake
#@TYPE: Machine
#@NAME: Orangepi R1 plus LTS (RK3328 CPU)

require orangepi-r1plus.inc

KERNEL_DEVICETREE = "rockchip/rk3328-orangepi-r1-plus-lts.dtb"
IMAGE_BOOT_FILES = "Image-initramfs-orangepi-r1plus-lts.bin rk3328-orangepi-r1-plus-lts.dtb"

PREFERRED_VERSION_linux = "6.4%"
```

## conf/machine/orangepi-r1plus.conf
```bitbake
#@TYPE: Machine
#@NAME: Orangepi R1 plus (RK3328 CPU)

require orangepi-r1plus.inc

KERNEL_DEVICETREE = "rockchip/rk3328-orangepi-r1-plus.dtb"
IMAGE_BOOT_FILES = "Image-initramfs-orangepi-r1plus.bin rk3328-orangepi-r1-plus.dtb"

PREFERRED_VERSION_linux-orangepi = "6.4%"
```

## conf/machine/orangepi-r1plus.inc
```bitbake
require conf/machine/include/rk3328.inc

IMAGE_FSTYPES = "wic.gz wic.bmap"

UBOOT_MACHINE = "rk3328_defconfig"

RK_WIFIBT_FIRMWARES = " \
	rkwifibt-firmware-ap6356-wifi \
	rkwifibt-firmware-ap6356-bt \
	brcm-tools \
"

IMAGE_POSTPROCESS_COMMAND:remove = "gen_rkupdateimg;"

WKS_FILE = "orangepi-r1plus-imagedef.wks.in"

MACHINE_EXTRA_RRECOMMENDS += "kernel-modules"

PREFERRED_PROVIDER_virtual/kernel = "linux-orangepi"

KBUILD_DEFCONFIG = ""

MACHINE_FEATURES += "alsa"

IMAGE_INSTALL += "u-boot-fw-utils rockchip-libmali"

ORANGEPI_ROOTFS_PART_UUID = "614e0000-0000-4b53-8000-1d28000054a9"

INITRAMFS_IMAGE_BUNDLE = "1"

# Necessary because uboot sets the init script to /sbin/init_datapartition instead
# of /sbin/init
MACHINE_ESSENTIAL_EXTRA_RDEPENDS += "datapartition"
```
